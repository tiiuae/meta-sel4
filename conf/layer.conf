## conf/layer.conf
```bitbake
# We have a conf and classes directory, append to BBPATH
BBPATH .= ":${LAYERDIR}"

# We have a recipes directory, add to BBFILES
BBFILES += "${LAYERDIR}/recipes*/*/*.bb ${LAYERDIR}/recipes*/*/*.bbappend ${LAYERDIR}/images/*.bb"

BBFILE_COLLECTIONS += "meta-sel4"
BBFILE_PATTERN_meta-sel4 := "^${LAYERDIR}/"
BBFILE_PRIORITY_meta-sel4 = "30"

LAYERSERIES_COMPAT_meta-sel4 = "nanbield"
```

## conf/machine/vm-raspberrypi4-64.conf
```bitbake
# Additional overrides, least specific to most specific
MACHINEOVERRIDES = "raspberrypi4:raspberrypi4-64:${MACHINE}"

require include/sel4-vm.inc
require conf/machine/raspberrypi4-64.conf

RPI_USE_U_BOOT = "1"

ENABLE_UART = "1"

RPI_EXTRA_CONFIG = " \n \
    enable_jtag_gpio=1 \n \
    uart_2ndstage=1 \n \
"
```

## wic/vm-image-user.wks
```
# short-description: Create qcow2 image for Guest VMs

part / --source rootfs --fstype=ext4 --label root --align 4096
```
